## conf/machine/ouya.conf
```bitbake
#@TYPE: Machine
#@Name: tf201 
#@DESCRIPTION: Machine configuration for the ASUS tf201 

require conf/machine/include/tune-cortexa8.inc
PREFERRED_PROVIDER_virtual/libgl  = "mesa-dri"
PREFERRED_PROVIDER_virtual/libx11 ?= "libx11-trim"

PREFERRED_PROVIDER_virtual/xserver = "xserver-xorg"
XSERVER = "xserver-xorg \
           xf86-input-evdev \
           xf86-input-mouse \
           xf86-input-keyboard"


# has DVI connector for external screen
GUI_MACHINE_CLASS = "bigscreen"
MACHINE_DISPLAY_WIDTH_PIXELS = "1280"
MACHINE_DISPLAY_HEIGHT_PIXELS = "800"

#PREFERRED_PROVIDER_virtual/kernel = "linux-tf201"
PREFERRED_PROVIDER_virtual/kernel = "linux-dummy"

MACHINE_FEATURES = "kernel26 usbhost ext2 alsa"

#don't try to access tty1
USE_VT = "0"
IMAGE_DEVICE_TABLES = ""
SERIAL_CONSOLE = "115200 ttymxc0"
#UBOOT_ENTRYPOINT = "0x90008000"
#UBOOT_LOADADDRESS = "0x90008000"

#PREFERRED_PROVIDER_virtual/bootloader = "u-boot-efikamx"

#tune for ARMv7/Cortex A8
```
